## config/west.yml
```yaml
manifest:
  defaults:
    revision: main
  remotes:
    - name: zmkfirmware
      url-base: https://github.com/zmkfirmware
    - name: joelspadin
      url-base: https://github.com/joelspadin
  projects:
    - name: zmk
      remote: zmkfirmware
      #revision: V0.3
      #revision: main
      import: app/west.yml
    - name: zmk-locales
      remote: joelspadin
      revision: main
  self:
  #path: .
    path: config
    
```
