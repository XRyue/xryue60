/*
 * Copyright (c) 2020 Pete Johanson
 *
 * SPDX-License-Identifier: MIT
 */

#include "xryue60.dtsi"

&default_transform {
    col-offset = <7>;
};

&kscan0 {
col-gpios
			= <&gpio0 13 GPIO_ACTIVE_HIGH>
			, <&gpio0 24 GPIO_ACTIVE_HIGH>
			, <&gpio0 5 GPIO_ACTIVE_HIGH>
			, <&gpio1 9 GPIO_ACTIVE_HIGH>			
			, <&gpio0 31 GPIO_ACTIVE_HIGH>
			, <&gpio0 30 GPIO_ACTIVE_HIGH>
			, <&gpio0 29 GPIO_ACTIVE_HIGH>
			;
};
&right_encoder {
    status = "okay";
};
&right_encoder {
    sensor-bindings = <&inc_dec_kp C_VOL_UP C_VOL_DN>; // 左旋钮控制音量
};