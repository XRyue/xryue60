## config/boards/shields/xryue60/Kconfig.defconfig
```kconfig
# Copyright (c) 2020 The ZMK Contributors
# SPDX-License-Identifier: MIT

if SHIELD_xryue60

config ZMK_KEYBOARD_NAME
	default "xryue60"

endif
```

## config/boards/shields/xryue60/Kconfig.shield
```kconfig
# Copyright (c) 2020 Pete Johanson
# SPDX-License-Identifier: MIT

config SHIELD_XRYUE60_LEFT
    def_bool $(shields_list_contains,xryue60_left)

config SHIELD_XRYUE60_RIGHT
    def_bool $(shields_list_contains,xryue60_right)
```
